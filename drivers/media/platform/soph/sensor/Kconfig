## drivers/media/platform/soph/sensor/Kconfig
```kconfig
# SPDX-License-Identifier: GPL-2.0-only

config SENSOR_V4L2_IMX585
	depends on VIDEO_V4L2 && I2C
	tristate "imx585 support"
	default n
	help
	  Support for Sensor on the CV186X SoC.

config SENSOR_V4L2_IMX307
	depends on VIDEO_V4L2 && I2C
	tristate "imx307 support"
	default n
	help
	  Support for Sensor on the CV186X SoC.

config SENSOR_V4L2_IMX327
	depends on VIDEO_V4L2 && I2C
	tristate "imx327 support"
	default n
	help
	  Support for Sensor on the CV186X SoC.

config SENSOR_V4L2_IMX412
	depends on VIDEO_V4L2 && I2C
	tristate "imx412 support"
	default n
	help
	  Support for Sensor on the CV186X SoC.

config SENSOR_V4L2_LT6911
	depends on VIDEO_V4L2 && I2C
	tristate "lt6911 support"
	default n
	help
	  Support for Sensor on the CV186X SoC.

config SENSOR_V4L2_OS04A10
	depends on VIDEO_V4L2 && I2C
	tristate "os04a10 support"
	default n
	help
	  Support for Sensor on the CV186X SoC.

config SENSOR_V4L2_OS04E10
	depends on VIDEO_V4L2 && I2C
	tristate "os04e10 support"
	default n
	help
	  Support for Sensor on the CV186X SoC.

config SENSOR_V4L2_OS08B10
	depends on VIDEO_V4L2 && I2C
	tristate "os08b10 support"
	default n
	help
	  Support for Sensor on the Athena2 SoC.

config SENSOR_V4L2_GC4653
	depends on VIDEO_V4L2 && I2C
	tristate "gc4653 support"
	default n
	help
	  Support for Sensor on the CV186X SoC.

config SENSOR_V4L2_PR2100
	depends on VIDEO_V4L2 && I2C
	tristate "pr2100 support"
	default n
	help
	  Support for Sensor on the CV186X SoC.
```

## drivers/otp/Kconfig
```kconfig
# SPDX-License-Identifier: GPL-2.0-only
#
# Generic secure otp drivers configuration
#

menuconfig OTP
	bool "OTP drivers"
	default y
	help
		OTP drivers offer a generic mechanism for
		secure otp management.

if OTP

config SECURE_OTP
	tristate "secure otp driver"
	default y
	help
		Select this driver for CVITEK A2 secure otp
		This driver is used for program and read otp
		This driver can also be built as a module
		But build-in is better.

endif
```
